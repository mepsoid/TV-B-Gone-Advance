; -----------------------------------------------------------------------------
; Code 132 - Advent, Baur, Beko, Bush, Carver, Crosley, Curtis Mathes, Dual,
; Hanseatic, Hitachi, Infinity, Inerfunk, Intervision, JBL, Jensen, LG,
; LG/GoldStar, Lifetec, Loewe, LXI, M Electronic, Magnavox, Marantz,
; Mitsubishi, Otto Versand, Philco, Philips, Philips Magnavox, Quelle,
; Schneider, Sears, SEQ Sylvania, Teac, Teknika, Thorn, Universum, Vidikron,
; Wards, Watson

; Carrier Freq = 34.80 KHz
.db (((XTAL / 34800.0) / 2.0) - 1.0), 92

.db 1, 1 ; 92       92
.db 2, 1 ; 184       92
.db 1, 1 ; 92       92
.db 1, 1 ; 92       92
.db 1, 1 ; 92       92
.db 1, 1 ; 92       92
.db 1, 1 ; 92       92
.db 1, 1 ; 92       92
.db 1, 2 ; 92      184
.db 1, 1 ; 92       92
.db 2, 1 ; 184       92
.db 1, 100 ; 92     9217
.db 1, 1 ; 92       92
.db 2, 1 ; 184       92
.db 1, 1 ; 92       92
.db 1, 1 ; 92       92
.db 1, 1 ; 92       92
.db 1, 1 ; 92       92
.db 1, 1 ; 92       92
.db 1, 1 ; 92       92
.db 1, 2 ; 92      184
.db 1, 1 ; 92       92
.db 2, 1 ; 184       92
.db 1, 0 ; 92        0
