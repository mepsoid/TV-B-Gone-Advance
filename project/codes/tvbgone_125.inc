; -----------------------------------------------------------------------------
; Code 125 - ASA, Dumont, Elin, Finlux, Fisher, Kapsch, Lenco, M Electronic,
; Murphy, Quelle, Sanyo, Tensai, Thorn, Universum

; Carrier Freq = 29.51 KHz
.db (((XTAL / 29510.0) / 2.0) - 1.0), 54

.db 1, 5 ; 54      272
.db 1, 1 ; 54       55
.db 1, 1 ; 54       55
.db 1, 1 ; 54       55
.db 1, 1 ; 54       55
.db 1, 1 ; 54       55
.db 1, 1 ; 54       55
.db 1, 1 ; 54       55
.db 1, 1 ; 54       55
.db 1, 1 ; 54       55
.db 1, 39 ; 54     2108
.db 1, 5 ; 54      270
.db 1, 2 ; 54      111
.db 1, 1 ; 54       55
.db 2, 1 ; 105       56
.db 1, 2 ; 54      111
.db 1, 1 ; 54       55
.db 1, 1 ; 54       55
.db 1, 1 ; 54       55
.db 1, 1 ; 54       55
.db 1, 230 ; 54     12444
.db 1, 5 ; 54      270
.db 1, 2 ; 54      111
.db 1, 1 ; 54       55
.db 2, 1 ; 105       56
.db 1, 2 ; 54      111
.db 1, 1 ; 54       55
.db 1, 1 ; 54       55
.db 1, 1 ; 54       55
.db 1, 1 ; 54       55
.db 1, 0 ; 54        0
