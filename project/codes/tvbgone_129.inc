; -----------------------------------------------------------------------------
; Code 129 - Thomson

; Carrier Freq = 32.52 KHz
.db (((XTAL / 32520.0) / 2.0) - 1.0), 52

.db 1, 4 ; 52      209
.db 1, 4 ; 52      209
.db 1, 9 ; 52      466
.db 1, 9 ; 52      466
.db 1, 4 ; 52      209
.db 1, 4 ; 52      209
.db 1, 4 ; 52      209
.db 1, 9 ; 52      466
.db 1, 9 ; 52      466
.db 1, 9 ; 52      466
.db 1, 4 ; 52      209
.db 1, 4 ; 52      209
.db 1, 72 ; 52     3788
.db 1, 4 ; 52      209
.db 1, 4 ; 52      209
.db 1, 9 ; 52      466
.db 1, 9 ; 52      466
.db 1, 4 ; 52      209
.db 1, 4 ; 52      209
.db 1, 4 ; 52      209
.db 1, 9 ; 52      466
.db 1, 9 ; 52      466
.db 1, 9 ; 52      466
.db 1, 4 ; 52      209
.db 1, 4 ; 52      209
.db 1, 0 ; 52        0
