; -----------------------------------------------------------------------------
; Code 137 - Alba, Bush, Cimline, Firstline, Goodmans, Hinari, Kendo, Manesth,
; Matsui, Orion, Otto Versand, Saisho, Sinudyne, Sunkai

; Carrier Freq = 37.47 KHz
.db (((XTAL / 37470.0) / 2.0) - 1.0), 57

.db 16, 8 ; 924      462
.db 1, 1 ; 56       56
.db 1, 1 ; 56       56
.db 1, 1 ; 56       56
.db 1, 1 ; 56       56
.db 1, 1 ; 56       56
.db 1, 1 ; 56       56
.db 1, 1 ; 56       56
.db 1, 3 ; 56      174
.db 1, 3 ; 56      174
.db 1, 3 ; 56      174
.db 1, 3 ; 56      174
.db 1, 3 ; 56      174
.db 1, 1 ; 56       56
.db 1, 3 ; 56      174
.db 1, 3 ; 56      174
.db 1, 1 ; 56       56
.db 1, 1 ; 56       56
.db 1, 3 ; 56      174
.db 1, 1 ; 56       56
.db 1, 3 ; 56      174
.db 1, 1 ; 56       56
.db 1, 1 ; 56       56
.db 1, 1 ; 56       56
.db 1, 1 ; 56       56
.db 1, 3 ; 56      174
.db 1, 1 ; 56       56
.db 1, 3 ; 56      174
.db 1, 1 ; 56       56
.db 1, 3 ; 56      174
.db 1, 3 ; 56      174
.db 1, 3 ; 56      174
.db 1, 3 ; 56      174
.db 1, 71 ; 56     4055
.db 16, 4 ; 926      230
.db 1, 173 ; 56     9857
.db 16, 4 ; 926      230
.db 1, 0 ; 56        0
