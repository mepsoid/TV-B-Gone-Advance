; -----------------------------------------------------------------------------
; Code 123 - ASA, Carrefour, Dumont, Emerson, Finlux, Grundig, Minerva,
; Nobliko, Quelle, Rank, RBM, Toshiba, Universum

; Carrier Freq = 30.46 KHz
.db (((XTAL / 30460.0) / 2.0) - 1.0), 51

.db 1, 5 ; 53      255
.db 1, 2 ; 53      102
.db 2, 1 ; 105       51
.db 1, 1 ; 53       51
.db 1, 1 ; 53       51
.db 1, 1 ; 53       51
.db 1, 48 ; 53     2439
.db 1, 5 ; 53      256
.db 1, 2 ; 53      102
.db 2, 2 ; 105      102
.db 1, 1 ; 53       51
.db 1, 1 ; 53       51
.db 1, 1 ; 53       51
.db 1, 242 ; 53     12337
.db 1, 5 ; 53      256
.db 1, 2 ; 53      102
.db 2, 2 ; 105      102
.db 1, 1 ; 53       51
.db 1, 1 ; 53       51
.db 1, 1 ; 53       51
.db 1, 0 ; 53        0
