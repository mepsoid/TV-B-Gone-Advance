; -----------------------------------------------------------------------------
; Code 127 - LG

; Carrier Freq = 37.47 KHz
.db (((XTAL / 37470.0) / 2.0) - 1.0), 57

.db 16, 8 ; 924      464
.db 1, 1 ; 58       57
.db 1, 1 ; 58       57
.db 1, 3 ; 58      173
.db 1, 1 ; 58       57
.db 1, 1 ; 58       57
.db 1, 1 ; 58       57
.db 1, 1 ; 58       57
.db 1, 1 ; 58       57
.db 1, 3 ; 58      173
.db 1, 3 ; 58      173
.db 1, 1 ; 58       57
.db 1, 3 ; 58      173
.db 1, 3 ; 58      173
.db 1, 3 ; 58      173
.db 1, 3 ; 58      173
.db 1, 3 ; 58      173
.db 1, 1 ; 58       57
.db 1, 1 ; 58       57
.db 1, 1 ; 58       57
.db 1, 3 ; 58      173
.db 1, 1 ; 58       57
.db 1, 1 ; 58       57
.db 1, 1 ; 58       57
.db 1, 1 ; 58       57
.db 1, 3 ; 58      173
.db 1, 3 ; 58      173
.db 1, 3 ; 58      173
.db 1, 1 ; 58       57
.db 1, 3 ; 58      173
.db 1, 3 ; 58      173
.db 1, 3 ; 58      173
.db 1, 3 ; 58      173
.db 1, 71 ; 58     4054
.db 16, 4 ; 926      230
.db 1, 173 ; 58     9881
.db 16, 4 ; 926      230
.db 1, 0 ; 58        0
