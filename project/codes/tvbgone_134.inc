; -----------------------------------------------------------------------------
; Code 134 - Atlantic, Autovox, Expert, Fujitsu, Kapsch, Luma, Rex, Seleco,
; Stern, Teleton, Uher, Zanussi

; Carrier Freq = 38.97 KHz
.db (((XTAL / 38970.0) / 2.0) - 1.0), 15

.db 1, 46 ; 15      690
.db 1, 46 ; 15      691
.db 1, 46 ; 15      691
.db 1, 46 ; 15      691
.db 1, 46 ; 15      691
.db 1, 30 ; 15      456
.db 1, 30 ; 15      456
.db 1, 46 ; 15      691
.db 1, 46 ; 15      691
.db 1, 30 ; 15      456
.db 1, 30 ; 15      456
.db 1, 255 ; 15     4705 -- !!!
.db 1, 46 ; 15      691
.db 1, 46 ; 15      691
.db 1, 46 ; 15      691
.db 1, 46 ; 15      691
.db 1, 46 ; 15      691
.db 1, 30 ; 15      456
.db 1, 30 ; 15      456
.db 1, 46 ; 15      691
.db 1, 46 ; 15      691
.db 1, 30 ; 15      456
.db 1, 30 ; 15      456
.db 1, 0 ; 15        0
