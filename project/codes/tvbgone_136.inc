; -----------------------------------------------------------------------------
; Code 136 - Philips, Phonola, SBR, Schneider

; Carrier Freq = 32.48 KHz
.db (((XTAL / 32480.0) / 2.0) - 1.0), 51

.db 1, 6 ; 49      306
.db 1, 20 ; 52     1022
.db 1, 6 ; 52      304
.db 1, 20 ; 52     1022
.db 1, 6 ; 52      304
.db 1, 20 ; 52     1022
.db 1, 6 ; 52      304
.db 1, 13 ; 52      663
.db 1, 13 ; 52      663
.db 1, 13 ; 52      663
.db 1, 13 ; 52      663
.db 1, 6 ; 52      304
.db 1, 6 ; 52      304
.db 1, 61 ; 52     3137
.db 1, 6 ; 52      304
.db 1, 20 ; 52     1022
.db 1, 6 ; 52      304
.db 1, 20 ; 52     1022
.db 1, 6 ; 52      304
.db 1, 20 ; 52     1022
.db 1, 6 ; 52      304
.db 1, 13 ; 52      663
.db 1, 13 ; 52      663
.db 1, 13 ; 52      663
.db 1, 13 ; 52      663
.db 1, 6 ; 52      304
.db 1, 6 ; 52      304
.db 1, 0 ; 52        0
