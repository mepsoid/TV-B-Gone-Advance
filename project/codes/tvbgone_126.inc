; -----------------------------------------------------------------------------
; Code 126 - ASA, Elin, Finlux, Hitachi, M Electrtonic, Novatronic, Quelle,
; Tensai, Universum

; Carrier Freq = 33.60 KHz
.db (((XTAL / 33600.0) / 2.0) - 1.0), 51

.db 1, 5 ; 54      255
.db 1, 5 ; 54       99
.db 2, 1 ; 107       48
.db 1, 1 ; 54       49
.db 1, 1 ; 54       49
.db 1, 1 ; 54       49
.db 1, 1 ; 54       49
.db 1, 1 ; 54       49
.db 1, 1 ; 54       49
.db 1, 1 ; 54       49
.db 1, 1 ; 54       49
.db 1, 1 ; 54       49
.db 1, 1 ; 54       49
.db 1, 1 ; 54       49
.db 1, 1 ; 54       49
.db 1, 29 ; 54     1482
.db 1, 5 ; 54      256
.db 1, 2 ; 54       99
.db 1, 1 ; 54       49
.db 2, 1 ; 107       48
.db 1, 2 ; 54       99
.db 1, 1 ; 54       49
.db 1, 1 ; 54       49
.db 1, 1 ; 54       49
.db 2, 1 ; 107       99
.db 1, 1 ; 54       49
.db 1, 1 ; 54       49
.db 1, 1 ; 54       49
.db 1, 1 ; 54       49
.db 1, 1 ; 54       49
.db 1, 222 ; 54    11310
.db 1, 5 ; 54      256
.db 1, 2 ; 54       99
.db 1, 1 ; 54       49
.db 2, 1 ; 107       48
.db 1, 2 ; 54       99
.db 1, 1 ; 54       49
.db 1, 1 ; 54       49
.db 1, 1 ; 54       49
.db 2, 2 ; 107       99
.db 1, 1 ; 54       49
.db 1, 1 ; 54       49
.db 1, 1 ; 54       49
.db 1, 1 ; 54       49
.db 1, 1 ; 54       49
.db 1, 0 ; 54        0
