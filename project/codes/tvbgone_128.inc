; -----------------------------------------------------------------------------
; Code 128 - JVC

; Carrier Freq = 37.43 KHz
.db (((XTAL / 37430.0) / 2.0) - 1.0), 54

.db 16, 8 ; 862      431
.db 1, 3 ; 56      163
.db 1, 3 ; 56      163
.db 1, 3 ; 56      163
.db 1, 3 ; 56      163
.db 1, 3 ; 56      163
.db 1, 1 ; 56       53
.db 1, 1 ; 56       53
.db 1, 1 ; 56       53
.db 1, 3 ; 56      163
.db 1, 3 ; 56      163
.db 1, 3 ; 56      163
.db 1, 1 ; 56       53
.db 1, 3 ; 56      163
.db 1, 1 ; 56       53
.db 1, 3 ; 56      163
.db 1, 3 ; 56      163
.db 1, 32 ; 56     1741
.db 1, 3 ; 56      163
.db 1, 3 ; 56      163
.db 1, 3 ; 56      163
.db 1, 3 ; 56      163
.db 1, 3 ; 56      163
.db 1, 1 ; 56       53
.db 1, 1 ; 56       53
.db 1, 1 ; 56       53
.db 1, 3 ; 56      163
.db 1, 3 ; 56      163
.db 1, 3 ; 56      163
.db 1, 1 ; 56       53
.db 1, 3 ; 56      163
.db 1, 1 ; 56       53
.db 1, 3 ; 56      163
.db 1, 3 ; 56      163
.db 1, 32 ; 56     1741
.db 1, 3 ; 56      163
.db 1, 3 ; 56      163
.db 1, 3 ; 56      163
.db 1, 3 ; 56      163
.db 1, 3 ; 56      163
.db 1, 1 ; 56       53
.db 1, 1 ; 56       53
.db 1, 1 ; 56       53
.db 1, 3 ; 56      163
.db 1, 3 ; 56      163
.db 1, 3 ; 56      163
.db 1, 1 ; 56       53
.db 1, 3 ; 56      163
.db 1, 1 ; 56       53
.db 1, 3 ; 56      163
.db 1, 3 ; 56      163
.db 1, 0 ; 56        0
