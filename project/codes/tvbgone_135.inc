; -----------------------------------------------------------------------------
; Code 135 - Akura, Alba, Asuka, Basic Line, Blue Sky, BTC, Bush, Cybertron,
; Dainichi, Elite, Genexxa, GPM, Hinari, ICeS, Isukai, Kaisui, Nikkai, Osaki,
; Oso, Roadstar, Schneider, Standard, Susumu, Tandy, Tensai, Texet

; Carrier Freq = 34.80 KHz
.db (((XTAL / 34800.0) / 2.0) - 1.0), 89

.db 4, 4 ; 358      358
.db 1, 1 ; 89       90
.db 1, 3 ; 89      269
.db 1, 3 ; 89      269
.db 1, 1 ; 89       90
.db 1, 3 ; 89      269
.db 1, 1 ; 89       90
.db 1, 1 ; 89       90
.db 1, 3 ; 89      269
.db 1, 1 ; 89       90
.db 1, 3 ; 89      269
.db 1, 1 ; 89       90
.db 1, 1 ; 89       90
.db 1, 3 ; 89      269
.db 1, 1 ; 89       90
.db 1, 1 ; 89       90
.db 1, 3 ; 89      269
.db 1, 1 ; 89       90
.db 1, 3 ; 89      269
.db 1, 3 ; 89      269
.db 1, 1 ; 89       90
.db 1, 3 ; 89      269
.db 1, 1 ; 89       90
.db 1, 3 ; 89      269
.db 1, 3 ; 89      269
.db 1, 39 ; 89     3492
.db 4, 4 ; 359      358
.db 1, 1 ; 89       90
.db 1, 3 ; 89      269
.db 1, 3 ; 89      269
.db 1, 1 ; 89       90
.db 1, 3 ; 89      269
.db 1, 1 ; 89       90
.db 1, 1 ; 89       90
.db 1, 3 ; 89      269
.db 1, 1 ; 89       90
.db 1, 3 ; 89      269
.db 1, 1 ; 89       90
.db 1, 1 ; 89       90
.db 1, 3 ; 89      269
.db 1, 1 ; 89       90
.db 1, 1 ; 89       90
.db 1, 3 ; 89      269
.db 1, 1 ; 89       90
.db 1, 3 ; 89      269
.db 1, 3 ; 89      269
.db 1, 1 ; 89       90
.db 1, 3 ; 89      269
.db 1, 1 ; 89       90
.db 1, 3 ; 89      269
.db 1, 3 ; 89      269
db 1, 0 ; 89        0
